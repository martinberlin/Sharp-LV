## firmware_test/maxtouch_zephyr/sample.yaml
```yaml
sample:
  name: matouch
tests:
  sample.basic.blinky:
    tags:
      - gpio
    depends_on: gpio i2c
    integration_platforms:
      - esp32s2
```
